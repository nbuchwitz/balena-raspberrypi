## layers/meta-balena-raspberrypi/conf/machine/revpi-connect-4.conf
```bitbake
#@TYPE: Machine
#@NAME: RevPi Connect 4
#@DESCRIPTION: Machine configuration for RevPi Connect 4 board

require conf/machine/include/revpi4.inc

KERNEL_DEVICETREE:append = " \
	overlays/revpi-connect4.dtbo \
	overlays/revpi-dt-blob-overlay.dtb \
"
```

## layers/meta-balena-raspberrypi/conf/machine/revpi-connect-s.conf
```bitbake
#@TYPE: Machine
#@NAME: RevPi Connect S
#@DESCRIPTION: Machine configuration for RevPi Connect S board

require conf/machine/include/revpi4.inc

KERNEL_DEVICETREE:append = " \
	overlays/revpi-connect.dtbo \
	overlays/revpi-connect-dt-blob-overlay.dtb \
	overlays/revpi-connect-can.dtbo \
"
```

## layers/meta-balena-raspberrypi/conf/machine/revpi-connect-se.conf
```bitbake
#@TYPE: Machine
#@NAME: RevPi Connect SE
#@DESCRIPTION: Machine configuration for RevPi Connect SE board

require conf/machine/include/revpi4.inc

KERNEL_DEVICETREE:append = " \
	overlays/revpi-connect-se.dtbo \
	overlays/revpi-connect-se-dt-blob-overlay.dtb \
	overlays/revpi-connect-can.dtbo \
"
```

## layers/meta-balena-raspberrypi/conf/machine/revpi-core-3.conf
```bitbake
#@TYPE: Machine
#@NAME: RevPi Core 3
#@DESCRIPTION: Machine configuration for RevPi Core 3 board

require conf/machine/include/revpi.inc

KERNEL_DEVICETREE:append = " \
	overlays/revpi-core.dtbo \
	overlays/revpi-core-dt-blob-overlay.dtb \
"
```

## layers/meta-balena-raspberrypi/conf/machine/revpi-core-s-1.conf
```bitbake
#@TYPE: Machine
#@NAME: RevPi Core S 1.0
#@DESCRIPTION: Machine configuration for RevPi Core S 1.0 board

require conf/machine/include/revpi4.inc

KERNEL_DEVICETREE:append = " \
	overlays/revpi-core-s.dtbo \
	overlays/revpi-core-s-dt-blob-overlay.dtb \
"
```

## layers/meta-balena-raspberrypi/conf/machine/revpi-core-se.conf
```bitbake
#@TYPE: Machine
#@NAME: RevPi Core S
#@DESCRIPTION: Machine configuration for RevPi Core S board

require conf/machine/include/revpi4.inc

KERNEL_DEVICETREE:append = " \
	overlays/revpi-core-se-2022.dtbo \
	overlays/revpi-dt-blob-overlay.dtb \
"
```

## layers/meta-balena-raspberrypi/conf/machine/revpi-flat-s.conf
```bitbake
#@TYPE: Machine
#@NAME: RevPi Flat S
#@DESCRIPTION: Machine configuration for RevPi Flat S board

require conf/machine/include/revpi4.inc

KERNEL_DEVICETREE:append = " \
	overlays/revpi-flat-s.dtbo \
	overlays/revpi-dt-blob-overlay.dtb \
"
```
